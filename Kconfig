## Kconfig
```kconfig
# 自作の behavior。keymap で使っていれば自動で有効になる
DT_COMPAT_ZMK_BEHAVIOR_ACCEL_SCROLL := zmk,behavior-accel-scroll

config ZMK_BEHAVIOR_ACCEL_SCROLL
    bool
    default $(dt_compat_enabled,$(DT_COMPAT_ZMK_BEHAVIOR_ACCEL_SCROLL))
```
